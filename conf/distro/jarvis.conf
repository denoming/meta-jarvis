## conf/distro/jarvis.conf
```bitbake
DISTRO = "jarvis"
DISTRO_NAME = "Jarvis (J.A.R.V.I.S Embedded Linux Distro)"
DISTRO_VERSION = "0.1"
DISTRO_CODENAME = "nanbield"

SDK_VENDOR = "-jarsdk"
SDK_VERSION = "${@d.getVar('DISTRO_VERSION').replace('snapshot-${METADATA_REVISION}', 'snapshot')}"
SDK_VERSION[vardepvalue] = "${SDK_VERSION}"

MAINTAINER = "Denys Asauliak <denoming@google.com>"

TARGET_VENDOR = "-jarvis"

LOCALCONF_VERSION = "2"

JAR_DEFAULT_DISTRO_FEATURES = "multiarch opengl"
JAR_DEFAULT_EXTRA_RDEPENDS = "packagegroup-core-boot"
JAR_DEFAULT_EXTRA_RRECOMMENDS = "kernel-module-af-packet"

DISTRO_FEATURES ?= "${DISTRO_FEATURES_DEFAULT} ${JAR_DEFAULT_DISTRO_FEATURES}"
DISTRO_EXTRA_RDEPENDS += "${JAR_DEFAULT_EXTRA_RDEPENDS}"
DISTRO_EXTRA_RRECOMMENDS += "${JAR_DEFAULT_EXTRA_RRECOMMENDS}"

# Remove X11 and 3G features by default
DISTRO_FEATURES:remove = "x11 3g"

PREFERRED_VERSION_linux-yocto ?= "6.5%"
PREFERRED_VERSION_linux-yocto-rt ?= "6.5%"

SDK_NAME = "${DISTRO}-${TCLIBC}-${SDKMACHINE}-${IMAGE_BASENAME}-${TUNE_PKGARCH}-${MACHINE}"
SDKPATHINSTALL = "/opt/${DISTRO}/${SDK_VERSION}"

require conf/distro/include/no-static-libs.inc
require conf/distro/include/yocto-uninative.inc
require conf/distro/include/security_flags.inc
INHERIT += "uninative"

BB_SIGNATURE_HANDLER ?= "OEEquivHash"
BB_HASHSERVE ??= "auto"

TCLIBCAPPEND = ""

INIT_MANAGER = "systemd"

# We need debug symbols so that SPDX license manifests for the kernel work
KERNEL_EXTRA_FEATURES:append = " features/debug/debug-kernel.scc"

# Enable creation of SPDX manifests by default
INHERIT += "create-spdx"
```

## conf/layer.conf
```bitbake
# We have a conf and classes directory, add to BBPATH
BBPATH .= ":${LAYERDIR}"

# We have recipes-* directories, add to BBFILES
BBFILES += "${LAYERDIR}/recipes-*/*/*.bb \
            ${LAYERDIR}/recipes-*/*/*.bbappend"

BBFILE_COLLECTIONS += "jarvis"
BBFILE_PATTERN_jarvis = "^${LAYERDIR}/"
BBFILE_PRIORITY_jarvis = "6"

LAYERDEPENDS_jarvis = "core"
LAYERSERIES_COMPAT_jarvis = "nanbield"
```
